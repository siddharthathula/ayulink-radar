// AyuLink host test runner — protocol v2, downlink queue, fall detector.
//
// Compiled with g++ on the host and run with firmware/test/run_tests.sh.
// The SAME headers are compiled into the ESP32 firmware, so a protocol or
// state-machine bug fails here rather than on a patient.
//
//   g++ -std=c++14 -O2 -I../common test_firmware.cpp -lcrypto -o /tmp/t && /tmp/t
//
// Honesty note on the fall harness (Phase 7):
//   The confusion matrix printed at the end is measured against SYNTHETIC
//   accelerometer traces generated by this file. It measures the STATE MACHINE,
//   not human physiology. It is NOT clinical validation and must never be
//   quoted as a device accuracy figure. See docs/VALIDATION.md.

#include "../common/ayulink_protocol.h"
#include "../common/fall_detector.h"
#include "../common/tremor_detector.h"
#include "../common/downlink_queue.h"
#include "../common/ayulink_discovery.h"
#include "../common/ppg_filter.h"
#include "../common/servo_angles.h"

#include <openssl/hmac.h>
#include <cstdio>
#include <cstring>
#include <cstdint>
#include <cmath>
#include <vector>
#include <string>

using namespace ayulink;

// ── tiny test harness ─────────────────────────────────────────────────────
static int g_pass = 0, g_fail = 0;
static const char* g_section = "";

#define SECTION(name) do { g_section = name; printf("\n\033[1m== %s ==\033[0m\n", name); } while (0)
#define CHECK(cond, ...) do { \
    if (cond) { g_pass++; printf("  \033[32mPASS\033[0m %-52s\n", #cond); } \
    else { g_fail++; printf("  \033[31mFAIL\033[0m %-52s ", #cond); printf(__VA_ARGS__); printf("\n"); } \
  } while (0)

// HMAC-SHA256, truncated to kTagBytes. On the device this same callback is
// backed by mbedtls/sha256.h.
static bool hmac_cb(const uint8_t* key, size_t key_len,
                    const uint8_t* msg, size_t msg_len,
                    uint8_t* out_tag) {
  unsigned char full[32];
  unsigned int len = 0;
  HMAC(EVP_sha256(), key, (int)key_len, msg, msg_len, full, &len);
  memcpy(out_tag, full, kTagBytes);
  return true;
}

// ── deterministic PRNG so results are reproducible ────────────────────────
struct Rng {
  uint32_t s;
  explicit Rng(uint32_t seed) : s(seed ? seed : 1) {}
  uint32_t next() { s ^= s << 13; s ^= s >> 17; s ^= s << 5; return s; }
  float uni() { return (next() & 0xFFFFFF) / 16777216.0f; }
  float sym(float amp) { return (uni() * 2.0f - 1.0f) * amp; }
};

// ═══════════════════════════════════════════════════════════════════════════
// PROTOCOL v2
// ═══════════════════════════════════════════════════════════════════════════
static const uint8_t KEY[16] = {'a','y','u','l','i','n','k','-','p','r','o','t','o','-','k','1'};
static const uint8_t BADKEY[16] = {'x','x','x','x','x','x','x','x','x','x','x','x','x','x','x','x'};

static TelemetryV2 make_t(uint16_t dev, uint16_t seq, uint8_t ev) {
  TelemetryV2 t; memset(&t, 0, sizeof(t));
  t.magic = kProtoMagic; t.device_id = dev; t.seq = seq; t.event = ev;
  t.flags = FLAG_GPS_LIVE;
  t.hr_bpm_x2 = 148; t.spo2_pct_x2 = 194; t.temp_c_x10 = 368;
  t.sensor_status = SS_OK; t.batt_pct = 88;
  t.lat_e7 = 176475180; t.lng_e7 = 778008960; t.uptime_s = 4242;
  return t;
}

static void test_protocol() {
  SECTION("Protocol v2 — encode / verify / integrity");
  uint8_t buf[kTelemetrySize];

  TelemetryV2 t = make_t(108, 7, EV_NORMAL);
  size_t n = encode_telemetry(t, buf, KEY, sizeof(KEY), hmac_cb);
  CHECK(n == kTelemetrySize, "got %zu", n);
  CHECK(verify_telemetry(buf, kTelemetrySize, KEY, sizeof(KEY), hmac_cb), "valid packet must verify");

  // wrong key must fail (forgery / wrong-gateway detection)
  CHECK(!verify_telemetry(buf, kTelemetrySize, BADKEY, sizeof(BADKEY), hmac_cb), "wrong key must NOT verify");

  // every single-bit flip in the authenticated region must be rejected
  int detected = 0, total = 0;
  for (size_t byte = 0; byte < kTelemetryBody; ++byte) {
    for (int bit = 0; bit < 8; ++bit) {
      ++total;
      buf[byte] ^= (uint8_t)(1 << bit);
      bool ok = verify_telemetry(buf, kTelemetrySize, KEY, sizeof(KEY), hmac_cb);
      if (!ok) ++detected;
      buf[byte] ^= (uint8_t)(1 << bit);
    }
  }
  CHECK(detected == total, "%d/%d bit flips detected", detected, total);

  // v1 packet (magic 0xAA, 14 bytes) must be rejected outright, not misparsed
  uint8_t v1[14] = {0xAA,108,74,98,0x00,0x70,0,0,0,0,0,0,0x00,0x55};
  CHECK(!verify_telemetry(v1, 14, KEY, sizeof(KEY), hmac_cb), "v1 14-byte packet must be rejected");

  // wrong size rejected
  CHECK(!verify_telemetry(buf, kTelemetrySize - 1, KEY, sizeof(KEY), hmac_cb), "truncated must be rejected");

  SECTION("Protocol v2 — decode + INVALID sentinels");
  TelemetryV2 d; decode_telemetry(buf, &d);
  CHECK(d.device_id == 108 && d.seq == 7, "identity/seq survive roundtrip");
  CHECK(fabsf(hr_bpm(d) - 74.0f) < 0.01f, "hr decoded %f", hr_bpm(d));
  CHECK(fabsf(spo2_pct(d) - 97.0f) < 0.01f, "spo2 decoded %f", spo2_pct(d));
  CHECK(fabsf(temp_c(d) - 36.8f) < 0.01f, "temp decoded %f", temp_c(d));
  CHECK(fabsf(lat_deg(d) - 17.647518) < 1e-4, "lat decoded %.6f", lat_deg(d));

  // INVALID sentinels must round-trip as "not a number"
  TelemetryV2 bad = make_t(108, 8, EV_SENSOR_FAULT);
  bad.sensor_status = SS_FAULT; bad.hr_bpm_x2 = 0; bad.spo2_pct_x2 = 0; bad.temp_c_x10 = 0;
  encode_telemetry(bad, buf, KEY, sizeof(KEY), hmac_cb);
  decode_telemetry(buf, &d);
  CHECK(!hr_valid(d), "faulty sensor -> hr INVALID");
  CHECK(!spo2_valid(d), "faulty sensor -> spo2 INVALID");
  CHECK(!temp_valid(d), "faulty sensor -> temp INVALID");
  CHECK(hr_bpm(d) < 0, "hr accessor returns negative, never a fake 74");

  // an UNKNOWN sensor must also be forced to INVALID
  TelemetryV2 unk = make_t(108, 9, EV_NORMAL);
  unk.sensor_status = SS_UNKNOWN; unk.hr_bpm_x2 = 148; unk.spo2_pct_x2 = 196; unk.temp_c_x10 = 370;
  encode_telemetry(unk, buf, KEY, sizeof(KEY), hmac_cb);
  decode_telemetry(buf, &d);
  CHECK(!hr_valid(d) && !spo2_valid(d) && !temp_valid(d), "UNKNOWN sensor forced to INVALID");

  SECTION("Protocol v2 — sequence / replay window");
  SeqWindow w(64);
  CHECK(w.accept(1) == SeqWindow::kAccept, "seq 1 accept");
  CHECK(w.accept(1) == SeqWindow::kRejectDuplicate, "seq 1 replay rejected");
  CHECK(w.accept(2) == SeqWindow::kAccept, "seq 2 accept");
  CHECK(w.accept(1) == SeqWindow::kRejectStale, "out-of-order seq 1 rejected");
  CHECK(w.accept(5) == SeqWindow::kAccept, "seq 5 accept");
  CHECK(w.accept(4) == SeqWindow::kRejectStale, "stale seq 4 rejected");
  CHECK(SeqWindow::newer(3, 65535), "wraparound: 3 is newer than 65535");
  CHECK(SeqWindow::newer(0, 65535), "wraparound: 0 is newer than 65535");
  SeqWindow w2(64);
  w2.accept(65534);
  CHECK(w2.accept(0) == SeqWindow::kAccept, "65534 -> 0 wraparound accepted");
  w2.reset();
  CHECK(w2.accept(1) == SeqWindow::kAccept, "reset clears replay state");

  SECTION("Protocol v2 — ACK correlation");
  uint8_t abuf[kAckSize];
  size_t an = encode_ack(108, 7, ACK_DISPATCH, 0, abuf, KEY, sizeof(KEY), hmac_cb);
  CHECK(an == kAckSize, "ack encodes to %zu", an);
  CHECK(verify_ack(abuf, kAckSize, KEY, sizeof(KEY), hmac_cb), "ack verifies");
  CHECK(!verify_ack(abuf, kAckSize, BADKEY, sizeof(BADKEY), hmac_cb), "ack wrong key rejected");
  AckV2 a; decode_ack(abuf, &a);
  CHECK(a.device_id == 108 && a.seq == 7 && a.ack_type == ACK_DISPATCH, "ack carries device+seq+type");
}

// ═══════════════════════════════════════════════════════════════════════════
// DOWNLINK QUEUE
// ═══════════════════════════════════════════════════════════════════════════
static void test_downlink() {
  SECTION("Downlink queue — priority, no-eviction, retry, ack");
  DownlinkQueue q(8);
  uint8_t p[4] = {1,2,3,4};

  // fill with telemetry ACKs, then try to add a CRITICAL dispatch
  for (int i = 0; i < 8; ++i) q.enqueue(p, 4, DL_TELEMETRY_ACK, 108, i, ACK_TELEMETRY_RX, 0, 1000, 3, 60000);
  CHECK(q.depth() == 8, "queue full at 8");
  CHECK(!q.enqueue(p, 4, DL_TELEMETRY_ACK, 108, 99, ACK_TELEMETRY_RX, 0, 1000, 3, 60000),
        "telemetry rejected when full (no room)");
  CHECK(q.enqueue(p, 4, DL_CRITICAL_COMMAND, 108, 50, ACK_DISPATCH, 0, 1000, 5, 60000),
        "CRITICAL evicts a telemetry ack to make room");
  CHECK(q.stats().evicted == 1, "eviction counted: %u", q.stats().evicted);
  CHECK(q.depth() == 8, "still bounded at 8");

  // the critical entry must be the one served
  const DlEntry* e = q.peek(0);
  CHECK(e && e->priority == DL_CRITICAL_COMMAND, "critical served first");

  // THE v1 REGRESSION TEST: flood telemetry ACKs while a dispatch is pending.
  // In v1 this destroyed the dispatch ACK. Here it must not.
  DownlinkQueue q2(8);
  q2.enqueue(p, 4, DL_CRITICAL_COMMAND, 108, 77, ACK_DISPATCH, 0, 1100, 5, 60000);
  for (int i = 0; i < 8; ++i) q2.enqueue(p, 4, DL_TELEMETRY_ACK, 108, 100+i, ACK_TELEMETRY_RX, 0, 1100, 1, 60000);
  const DlEntry* crit = nullptr;
  for (int t = 0; t < 5; ++t) {
    const DlEntry* x = q2.peek(0);
    if (x && x->priority == DL_CRITICAL_COMMAND) crit = x;
    if (x) q2.on_transmit(0, 1100);
  }
  CHECK(crit != nullptr, "dispatch ACK survived 8 telemetry ACKs across 5 retries");

  // ACK must retire exactly the matching entry
  DownlinkQueue q3(8);
  q3.enqueue(p, 4, DL_CRITICAL_COMMAND, 108, 90, ACK_DISPATCH, 0, 1000, 5, 60000);
  q3.enqueue(p, 4, DL_CLEAR_COMMAND, 108, 91, ACK_CLEAR, 0, 1000, 3, 60000);
  CHECK(q3.on_ack(108, 91, ACK_CLEAR, 0), "ack matches correct entry");
  CHECK(!q3.on_ack(108, 90, ACK_CLEAR, 0), "wrong ack_type does not retire dispatch");
  CHECK(q3.highest_priority() == DL_CRITICAL_COMMAND, "dispatch still queued after unrelated ack");

  // retries are bounded
  DownlinkQueue q4(4);
  q4.enqueue(p, 4, DL_CRITICAL_COMMAND, 108, 1, ACK_DISPATCH, 0, 10, 2, 60000);
  uint32_t t = 0; int sends = 0;
  while (q4.depth() && t < 200) { if (q4.peek(t)) { q4.on_transmit(t, 10); sends++; } t += 10; }
  CHECK(sends == 2, "exactly max_retries transmissions (got %d)", sends);

  // TTL expiry
  DownlinkQueue q5(4);
  q5.enqueue(p, 4, DL_CLEAR_COMMAND, 108, 1, ACK_CLEAR, 1000, 10, 9, 2000);
  const DlEntry* e5 = q5.peek(3500);
  CHECK(e5 == nullptr, "expired entry is not served");
  CHECK(q5.stats().expired >= 1, "expiry counted: %u", q5.stats().expired);
}

// ═══════════════════════════════════════════════════════════════════════════
// FALL DETECTION HARNESS
// ═══════════════════════════════════════════════════════════════════════════

struct Trace { std::vector<float> x, y, z; std::vector<uint32_t> dt; };

static void push(Trace& t, float ax, float ay, float az, uint32_t dt) {
  t.x.push_back(ax); t.y.push_back(ay); t.z.push_back(az); t.dt.push_back(dt);
}

// Held still, upright, ~1g on Z.
static void add_still(Trace& t, uint32_t ms, Rng& r, float tilt_deg = 0.0f) {
  uint32_t steps = ms / 20;
  for (uint32_t i = 0; i < steps; ++i) {
    float rad = tilt_deg * 3.14159265f / 180.0f;
    push(t, sinf(rad) + r.sym(0.03f), r.sym(0.03f), cosf(rad) + r.sym(0.03f), 20);
  }
}

// Walking: ~2 Hz vertical bob + swing, no sustained tilt.
static void add_walk(Trace& t, uint32_t ms, Rng& r) {
  uint32_t steps = ms / 20;
  for (uint32_t i = 0; i < steps; ++i) {
    float ph = (float)i * 0.126f;  // ~2 Hz at 50 Hz
    push(t, 0.16f * sinf(ph) + r.sym(0.05f), 0.05f * cosf(ph * 2) + r.sym(0.05f),
         1.0f - 0.22f * fabsf(sinf(ph)) + r.sym(0.05f), 20);
  }
}

// Controlled fall: free-fall -> impact -> body rotates to ~80 deg -> still.
static void add_fall(Trace& t, Rng& r, uint32_t still_ms = 7000) {
  for (uint32_t i = 0; i < 5; ++i) push(t, r.sym(0.05f), r.sym(0.05f), 0.25f, 20);   // ~100ms free-fall
  for (uint32_t i = 0; i < 4; ++i) push(t, r.sym(0.6f), r.sym(0.6f), 3.6f, 20);     // impact spike
  for (uint32_t i = 0; i < 20; ++i) {                                                 // body rotates over ~400ms
    float k = (float)i / 20.0f;
    float rad = 80.0f * k * 3.14159265f / 180.0f;
    push(t, sinf(rad) + r.sym(0.06f), r.sym(0.06f), cosf(rad) + r.sym(0.06f), 20);
  }
  add_still(t, still_ms, r, 80.0f);
}

// Band dropped onto a table: deceleration spike, small tilt, no real free-fall,
// and it stays upright. Must NOT be a fall.
static void add_drop(Trace& t, Rng& r) {
  for (uint32_t i = 0; i < 3; ++i) push(t, r.sym(0.3f), r.sym(0.3f), 0.75f, 20);
  for (uint32_t i = 0; i < 3; ++i) push(t, r.sym(0.8f), r.sym(0.8f), 2.9f, 20);
  add_still(t, 6000, r, 6.0f);
}

// Shaking in hand: high-frequency, high-g, never free-fall, stays upright.
static void add_shake(Trace& t, Rng& r, uint32_t ms) {
  uint32_t steps = ms / 20;
  for (uint32_t i = 0; i < steps; ++i) {
    float ph = (float)i * 0.9f;
    push(t, 0.9f * sinf(ph) + r.sym(0.4f), 0.8f * cosf(ph * 1.3f) + r.sym(0.4f),
         0.7f + 0.5f * fabsf(sinf(ph * 0.7f)) + r.sym(0.3f), 20);
  }
  add_still(t, 3000, r, 4.0f);
}

// Slumped: rotates to the side and is still, but NO high-g impact and only a
// shallow dip. The classic v1 false negative.
static void add_slump(Trace& t, Rng& r) {
  for (uint32_t i = 0; i < 10; ++i) push(t, r.sym(0.08f), r.sym(0.08f), 0.86f, 20);
  for (uint32_t i = 0; i < 30; ++i) {
    float k = (float)i / 30.0f;
    float rad = 75.0f * k * 3.14159265f / 180.0f;
    push(t, sinf(rad) + r.sym(0.05f), r.sym(0.05f), cosf(rad) + r.sym(0.05f), 20);
  }
  add_still(t, 8000, r, 75.0f);
}

// rest_tilt is how the band is WORN in that scenario (degrees from world up).
// Calibration learns this, so a scenario where the wrist is horizontal is no
// longer mistaken for a body lying on the ground.
struct Scenario { const char* name; bool should_detect; Trace tr; float rest_tilt = 0.0f; };

static std::vector<Scenario> build_scenarios() {
  std::vector<Scenario> v;
  auto run = [&](const char* n, bool expect, Trace t) {
    Trace pre; Rng rp(7); add_still(pre, 2000, rp);
    Trace merged;
    for (size_t i = 0; i < pre.x.size(); ++i) push(merged, pre.x[i], pre.y[i], pre.z[i], pre.dt[i]);
    for (size_t i = 0; i < t.x.size(); ++i) push(merged, t.x[i], t.y[i], t.z[i], t.dt[i]);
    v.push_back(Scenario{n, expect, merged});
  };

  Rng r1(11); { Trace t; add_fall(t, r1); run("controlled fall (seated->ground)", true, t); }
  Rng r2(12); { Trace t; add_fall(t, r2, 3000); run("fall, brief impact then still", true, t); }
  Rng r3(13); { Trace t; add_walk(t, 12000, r3); add_still(t, 3000, r3, 3.0f); run("walking 12s", false, t); }
  Rng r4(14); { Trace t; add_walk(t, 6000, r4); push(t, 0, 0, 1.0f, 20); add_still(t, 2000, r4, 8.0f); run("walk then sit upright", false, t); }
  Rng r5(15); { Trace t; add_still(t, 5000, r5, 3.0f); run("sitting still 5s", false, t); }
  Rng r6(16); { Trace t; add_drop(t, r6); run("band dropped on table", false, t); }
  Rng r7(17); { Trace t; add_shake(t, r7, 8000); run("shaking in hand 8s", false, t); }
  Rng r8(18); { Trace t; add_slump(t, r8); run("collapse to side, no impact spike", true, t); }
  Rng r9(19); { Trace t; add_walk(t, 4000, r9); add_shake(t, r9, 3000); add_still(t, 3000, r9, 5.0f); run("walk + shake + still", false, t); }
  // Deliberate TRADE-OFF, not a defect: a fall followed by a scramble within
  // ~1.5 s still escalates. That is the intended clinical pattern — escalate
  // fast, let the responder acknowledge/cancel downstream (Phase 2/6). A
  // detector that waits for certainty would miss the events that matter.
  Rng r10(20); { Trace t; add_still(t, 3000, r10, 2.0f); add_fall(t, r10, 0); for (uint32_t i=0;i<20;++i) push(t, r10.sym(0.9f), r10.sym(0.9f), 1.0f+r10.sym(0.5f), 20); add_still(t, 3000, r10, 80.0f); run("fall+scramble 400ms (escalate by design)", true, t); }
  // A fall where the person gets back UP and stays upright must not escalate.
  Rng r24(24); { Trace t; add_still(t, 2000, r24, 1.0f); add_fall(t, r24, 0); for (uint32_t i=0;i<25;++i){ float k=(float)i/25.f; float rad=80.f*(1.f-k)*3.14159265f/180.f; push(t, sinf(rad)+r24.sym(0.15f), r24.sym(0.15f), cosf(rad)+r24.sym(0.15f), 20);} add_still(t, 6000, r24, 2.0f); run("fall but stood back up", false, t); }
  Rng r11(21); { Trace t; add_fall(t, r11); add_still(t, 2500, r11, 80.0f); run("fall, slow recovery 2.5s", true, t); }
  Rng r23(23); { Trace t; add_still(t, 2000, r23, 0.0f); for (uint32_t i=0;i<40;++i){ float k=(float)i/40.f; float rad=72.f*k*3.14159265f/180.f; push(t, sinf(rad)+r23.sym(0.04f), r23.sym(0.04f), cosf(rad)+r23.sym(0.04f), 20);} add_still(t, 7000, r23, 72.0f); run("slow slide down wall, no impact", true, t); }
  Rng r12(22); { Trace t; add_still(t, 4000, r12, 1.0f); push(t, 0, 0, 0.55f, 20); push(t, 0, 0, 0.35f, 20);
                 for (uint32_t i=0;i<5;++i) push(t, r12.sym(0.5f), r12.sym(0.5f), 3.2f, 20);
                 for (uint32_t i=0;i<20;++i){ float k=(float)i/20.f; float rad=70.f*k*3.14159265f/180.f; push(t, sinf(rad)+r12.sym(0.05f), r12.sym(0.05f), cosf(rad)+r12.sym(0.05f), 20);}
                 add_still(t, 7000, r12, 70.0f); run("forward fall onto hands", true, t); }
  return v;
}

// The detector now learns the wearer's rest orientation before it will call
// anything a fall, so every harness must spend a still window first. This uses
// its own RNG so it never perturbs a scenario's deterministic trace.
static void calibrate(FallDetector& d, float tilt_deg = 0.0f, uint32_t seed = 7) {
  Rng cr(seed); Trace t; add_still(t, 2500, cr, tilt_deg);
  for (size_t i = 0; i < t.x.size(); ++i) d.update(t.x[i], t.y[i], t.z[i], t.dt[i]);
}

static void test_fall() {
  SECTION("Fall detector — state machine");
  FallConfig cfg{};
  FallDetector fd(cfg);
  calibrate(fd);
  CHECK(fd.rest_valid(), "rest orientation calibrated from a still window");
  Rng r(99); Trace t; add_fall(t, r);
  int confirms = 0;
  for (size_t i = 0; i < t.x.size(); ++i) if (fd.update(t.x[i], t.y[i], t.z[i], t.dt[i])) ++confirms;
  CHECK(confirms == 1, "exactly one confirm for one fall (got %d)", confirms);
  CHECK(fd.state() == FS_COOLDOWN, "ends in COOLDOWN, state=%s", fall_state_name(fd.state()));
  CHECK(confirms == 1, "one-shot confirm");

  // patient cancel during the pending window
  FallDetector fd2(cfg);
  calibrate(fd2, 0.0f, 8);
  Trace t2; Rng r2(101); add_fall(t2, r2, 3000);
  bool cancelled = false; int c2 = 0;
  for (size_t i = 0; i < t2.x.size(); ++i) {
    if (fd2.cancel_window_open() && !cancelled) { cancelled = true; fd2.cancel(); }
    if (fd2.update(t2.x[i], t2.y[i], t2.z[i], t2.dt[i])) ++c2;
  }
  CHECK(cancelled && c2 == 0, "cancel during window suppresses the alert");

  // physically impossible sample must not advance the machine
  FallDetector fd3(cfg);
  bool glitch = false;
  for (int i = 0; i < 200; ++i) if (fd3.update(0, 0, 99.0f, 20)) glitch = true;
  CHECK(!glitch, "99 g bus glitch produces no alert");

  SECTION("Fall detector — confusion matrix (SYNTHETIC TRACES, NOT CLINICAL)");
  auto scen = build_scenarios();
  int tp=0, fp=0, tn=0, fn=0;
  printf("\n  %-38s %-9s %-9s %s\n", "scenario", "expected", "detected", "result");
  printf("  %-38s %-9s %-9s %s\n", "--------------------------------------", "---------", "---------", "------");
  for (auto& s : scen) {
    FallDetector d(cfg);
    calibrate(d, s.rest_tilt, 31);
    int hits = 0;
    for (size_t i = 0; i < s.tr.x.size(); ++i)
      if (d.update(s.tr.x[i], s.tr.y[i], s.tr.z[i], s.tr.dt[i])) hits++;
    bool det = hits > 0;
    const char* verdict;
    if (s.should_detect && det)       { tp++; verdict = "TP"; }
    else if (!s.should_detect && det)  { fp++; verdict = "FP"; }
    else if (!s.should_detect && !det) { tn++; verdict = "TN"; }
    else                              { fn++; verdict = "FN"; }
    printf("  %-38s %-9s %-9s %s%s\n", s.name, s.should_detect ? "fall" : "no-fall",
           det ? "FALL" : "-", verdict, hits > 1 ? " (x2!)" : "");
  }
  double prec = (tp + fp) ? (double)tp / (tp + fp) : 0.0;
  double rec  = (tp + fn) ? (double)tp / (tp + fn) : 0.0;
  double acc  = (double)(tp + tn) / (double)(tp + tn + fp + fn);
  printf("\n  TP=%d FP=%d TN=%d FN=%d\n", tp, fp, tn, fn);
  printf("  precision=%.2f recall=%.2f accuracy=%.2f  (synthetic traces only)\n", prec, rec, acc);
  CHECK(tp + fp + tn + fn == (int)scen.size(), "every scenario classified");
  CHECK(fp == 0, "no false positives on the non-fall corpus (got %d)", fp);
  CHECK(rec >= 0.70, "recall >= 0.70 on the fall corpus (got %.2f)", rec);

  // ── Regression: the bug that made the band alert while simply being worn ──
  // v2 measured tilt against a hardcoded +Z axis. A wristband on a horizontal
  // forearm reads ~90 deg from that axis forever, and with the inertial path
  // enabled it confirmed a fall roughly every 23 seconds without any movement.
  // The wearer never fell; the band was just being worn.
  SECTION("Fall detector — worn horizontally must not alert (regression)");
  {
    FallConfig c{};
    FallDetector d(c);
    calibrate(d, 90.0f, 41);                 // forearm horizontal: gravity on X
    CHECK(d.rest_valid(), "rest axis learned at 90 deg of world up");
    Rng r(4242);
    Trace worn; add_still(worn, 180000, r, 90.0f);   // 3 minutes, motionless
    int hits = 0;
    for (size_t i = 0; i < worn.x.size(); ++i)
      if (d.update(worn.x[i], worn.y[i], worn.z[i], worn.dt[i])) ++hits;
    CHECK(hits == 0, "3 min stationary at 90 deg produces no fall (got %d)", hits);

    // Same again at 75 deg, and at 120 deg, to cover the whole plausible range
    // of how a forearm can sit relative to gravity.
    int worst = 0;
    for (float tilt = 45.0f; tilt <= 135.0f; tilt += 15.0f) {
      FallDetector e(c);
      calibrate(e, tilt, 43);
      Rng rr(77); Trace w; add_still(w, 120000, rr, tilt);
      int h = 0;
      for (size_t i = 0; i < w.x.size(); ++i)
        if (e.update(w.x[i], w.y[i], w.z[i], w.dt[i])) ++h;
      if (h > worst) worst = h;
    }
    CHECK(worst == 0, "no false alerts at any resting orientation (worst=%d)", worst);
  }

  // ── One fall, one alert, even if the wearer stays on the floor ───────────
  SECTION("Fall detector — stays quiet while the wearer is still down");
  {
    FallConfig c{};
    FallDetector d(c);
    calibrate(d);
    Rng r(555);
    Trace t; add_fall(t, r, 60000);           // fall, then 60 s on the ground
    int hits = 0;
    for (size_t i = 0; i < t.x.size(); ++i)
      if (d.update(t.x[i], t.y[i], t.z[i], t.dt[i])) ++hits;
    CHECK(hits == 1, "one fall alerts once, not repeatedly (got %d)", hits);
    CHECK(!d.armed(), "disarmed while still down");

    // Getting back up and wearing it normally re-arms it for the next fall.
    Rng r2(556); Trace up; add_still(up, 5000, r2, 0.0f);
    for (size_t i = 0; i < up.x.size(); ++i) d.update(up.x[i], up.y[i], up.z[i], up.dt[i]);
    CHECK(d.armed(), "re-arms after returning upright");

    Rng r3(557); Trace t2; add_fall(t2, r3);
    int hits2 = 0;
    for (size_t i = 0; i < t2.x.size(); ++i)
      if (d.update(t2.x[i], t2.y[i], t2.z[i], t2.dt[i])) ++hits2;
    CHECK(hits2 == 1, "detects the NEXT real fall after re-arming (got %d)", hits2);
  }

  // ── No verdict without a trustworthy rest orientation ────────────────────
  SECTION("Fall detector — refuses to guess before calibration");
  {
    FallConfig c{};
    FallDetector d(c);
    // Walking never presents a still window, so the rest axis stays unknown and
    // no verdict may be issued. (A fall trace that ENDS motionless does calibrate
    // legitimately - the trailing stillness is a real rest sample - which is why
    // this uses continuous movement instead.)
    Rng r(9); Trace t; add_walk(t, 4000, r);
    int hits = 0;
    for (size_t i = 0; i < t.x.size(); ++i)
      if (d.update(t.x[i], t.y[i], t.z[i], t.dt[i])) ++hits;
    CHECK(!d.rest_valid(), "never calibrated while the band keeps moving");
    CHECK(hits == 0, "no alert while uncalibrated rather than a wrong one (got %d)", hits);

    // Explicit recalibration clears the learned axis.
    d.recalibrate();
    CHECK(!d.rest_valid(), "recalibrate() clears the rest axis");
  }
  printf("  \033[33mNOTE: synthetic. Not a clinical accuracy claim. See docs/VALIDATION.md\033[0m\n");
}

// ── SeqWindow: slot coverage, capacity clamping, wraparound ──────────────
// The replay bitmap is indexed by `seq % 256`, not `seq % capacity_`. The old
// code declared 256 slots but indexed with a caller-chosen capacity, so a
// capacity above 256 would have read past the end of both arrays.
static void test_seq_window() {
  SECTION("sequence window");

  // Capacity is clamped to the bitmap, so a caller cannot overflow it.
  {
    ayulink::SeqWindow big(4096);
    CHECK(big.capacity() <= ayulink::SeqWindow::kSlots,
          "capacity clamped to %u slots (got %u)",
          (unsigned)ayulink::SeqWindow::kSlots, (unsigned)big.capacity());
  }
  {
    ayulink::SeqWindow zero(0);
    CHECK(zero.capacity() >= 1, "capacity floor of 1 honoured");
  }
  CHECK(ayulink::SeqWindow::kSlots == 256, "replay bitmap covers the 16-bit seq space");

  // Every reachable slot index must stay in bounds.
  bool all_in_bounds = true;
  for (uint32_t i = 0; i <= 65535u; ++i) {
    const size_t slot = (size_t)(uint16_t)i % ayulink::SeqWindow::kSlots;
    if (slot >= ayulink::SeqWindow::kSlots) { all_in_bounds = false; break; }
  }
  CHECK(all_in_bounds, "all 65536 sequence values map in-bounds");

  // Replay + stale rejection still behave after the change.
  {
    ayulink::SeqWindow w(1000);
    CHECK(w.accept(10) == ayulink::SeqWindow::kAccept, "fresh seq accepted");
    CHECK(w.accept(10) == ayulink::SeqWindow::kRejectDuplicate, "replay rejected");
    CHECK(w.accept(11) == ayulink::SeqWindow::kAccept, "next seq accepted");
    CHECK(w.accept(9) == ayulink::SeqWindow::kRejectStale, "older seq rejected");
    CHECK(w.highest() == 11, "highest tracks the newest accepted seq");
  }

  // Wraparound: 65535 -> 0 must read as NEWER, not stale.
  {
    ayulink::SeqWindow r;
    r.accept(65535);
    CHECK(r.accept(0) == ayulink::SeqWindow::kAccept,
          "seq wraps 65535 -> 0 as newer (no replay-lockout)");
    CHECK(r.accept(65535) == ayulink::SeqWindow::kRejectStale,
          "pre-wrap seq rejected after wrap");
  }

  // reset() must clear the replay bitmap, not just the high-water mark.
  {
    ayulink::SeqWindow w;
    w.accept(7);
    w.reset();
    CHECK(w.accept(7) == ayulink::SeqWindow::kAccept,
          "reset clears the bitmap so the same seq is fresh again");
  }
}



// ── Backend discovery: reply parsing + cache ───────────────────────────────
// The laptop's IP changes every time the hotspot hands out a new lease, so this
// path is what keeps the boards connected. A parser that accepted a malformed
// reply would point the device at some unrelated host.

static void test_discovery_reply_parsing() {
  ayulink::DiscoveryResult r;

  // The exact shape the backend emits.
  const char* good = "AYULINK_DISCOVER_V1 192.168.137.1 8000 gateway=/ws/gateway hub=/ws/hub";
  CHECK(ayulink::parseDiscoveryReply(good, strlen(good), &r), "valid reply accepted");
  CHECK(r.ok(), "result marked ok");
  CHECK(r.ip_be == 0xC0A88901u, "192.168.137.1 -> 0xC0A88901 (got 0x%08X)", (unsigned)r.ip_be);
  CHECK(r.port == 8000, "port parsed (got %u)", (unsigned)r.port);
  CHECK(r.source == ayulink::kDiscoveryBroadcast, "source = broadcast");

  // Windows Mobile Hotspot subnet and a typical phone-hotspot subnet.
  const char* win = "AYULINK_DISCOVER_V1 10.66.212.237 8000";
  CHECK(ayulink::parseDiscoveryReply(win, strlen(win), &r), "192.168-style LAN ip accepted");
  CHECK(r.ip_be == 0x0A42D4EDu, "10.66.212.237 -> 0x0A42D4ED (got 0x%08X)", (unsigned)r.ip_be);

  const char* phone = "AYULINK_DISCOVER_V1 172.20.10.1 8000 gateway=x";
  CHECK(ayulink::parseDiscoveryReply(phone, strlen(phone), &r), "iPhone-hotspot ip accepted");
  CHECK(r.ip_be == 0xAC140A01u, "172.20.10.1 -> 0xAC140A01 (got 0x%08X)", (unsigned)r.ip_be);

  // 0.x.x.x is never a usable peer.
  const char* zero = "AYULINK_DISCOVER_V1 0.0.0.0 8000";
  CHECK(!ayulink::parseDiscoveryReply(zero, strlen(zero), &r), "0.0.0.0 rejected");

  // Malformed input must be rejected, not half-applied.
  const char* wrongmagic = "SOMETHING_ELSE 10.0.0.1 8000";
  CHECK(!ayulink::parseDiscoveryReply(wrongmagic, strlen(wrongmagic), &r), "wrong magic rejected");

  const char* oob = "AYULINK_DISCOVER_V1 999.1.1.1 8000";
  CHECK(!ayulink::parseDiscoveryReply(oob, strlen(oob), &r), "octet >255 rejected");

  const char* noport = "AYULINK_DISCOVER_V1 10.0.0.1";
  CHECK(!ayulink::parseDiscoveryReply(noport, strlen(noport), &r), "missing port rejected");

  const char* noip = "AYULINK_DISCOVER_V1";
  CHECK(!ayulink::parseDiscoveryReply(noip, strlen(noip), &r), "magic only rejected");

  const char* badport = "AYULINK_DISCOVER_V1 10.0.0.1 99999";
  CHECK(!ayulink::parseDiscoveryReply(badport, strlen(badport), &r), "port >65535 rejected");

  CHECK(!ayulink::parseDiscoveryReply("", 0, &r), "empty reply rejected");
  CHECK(!ayulink::parseDiscoveryReply(good, strlen(good), nullptr), "null out rejected");
}

static void test_discovery_reply_is_bounded() {
  // A hostile or buggy peer must not be able to overrun the parser's buffer.
  ayulink::DiscoveryResult r;
  char big[4096];
  memset(big, 'A', sizeof(big));
  memcpy(big, ayulink::kDiscoveryMagic, strlen(ayulink::kDiscoveryMagic));
  bool r1 = ayulink::parseDiscoveryReply(big, sizeof(big), &r);
  CHECK(!r1, "oversized junk reply rejected");
  CHECK(!r.ok(), "rejected reply does not leave a usable result");
}

static void test_discovery_cache() {
  ayulink::DiscoveryCache cache;
  CHECK(!cache.valid(), "cache starts empty");
  CHECK(!cache.get(8000).ok(), "empty cache misses");

  ayulink::DiscoveryResult hit;
  hit.ip_be = 0x0A42D4EDu;
  hit.port = 8000;
  hit.source = ayulink::kDiscoveryBroadcast;
  cache.remember(hit);
  CHECK(cache.valid(), "cache valid after remember");

  ayulink::DiscoveryResult got = cache.get(8000);
  CHECK(got.ok(), "cache hit");
  CHECK(got.ip_be == 0x0A42D4EDu, "cached ip preserved");
  CHECK(got.source == ayulink::kDiscoveryCache, "reported as cache source");

  // A gateway asking for a different port must not reuse this answer.
  CHECK(!cache.get(8100).ok(), "port mismatch is not a cache hit");

  // An invalid result must never poison the cache.
  cache.clear();
  cache.remember(ayulink::DiscoveryResult::none());
  CHECK(!cache.valid(), "invalid result not remembered");
}


// ── PPG stabiliser ─────────────────────────────────────────────────────────
// Reproduces the reported defect: HR that "suddenly drops to very low values".
// The mechanism is a missed beat doubling the inter-beat interval, which halves
// the computed rate for one sample. These tests assert that never reaches the
// output, and that a genuine change still gets through.

static void test_ppg_rejects_the_doubled_interval() {
  ayulink::PpgStabiliser f;
  // Fill with a steady 60 bpm -> 1000 ms intervals.
  for (int i = 0; i < 6; i++) f.pushBeat(1000);
  CHECK(f.hasValue(), "value produced after steady beats");
  const float steady = f.current();
  CHECK(fabsf(steady - 60.0f) < 2.0f, "steady 60 bpm (got %.1f)", steady);

  // One missed beat -> 2000 ms -> naive maths says 30 bpm.
  ayulink::PpgReading r = f.pushBeat(2000);
  CHECK(r.held, "doubled interval flagged as held");
  CHECK(fabsf(r.bpm - steady) < 2.0f,
        "output held at ~60, NOT the naive 30 (got %.1f)", r.bpm);
  CHECK(f.rejected() > 0, "rejection counted");
}

static void test_ppg_rejects_the_spurious_fast_beat() {
  ayulink::PpgStabiliser f;
  for (int i = 0; i < 6; i++) f.pushBeat(1000);
  const float steady = f.current();

  // A single spurious beat half the interval -> naive 120 bpm.
  ayulink::PpgReading r = f.pushBeat(500);
  CHECK(fabsf(r.bpm - steady) < 5.0f, "spurious fast beat rejected (got %.1f)", r.bpm);
  CHECK(f.rejected() > 0, "rejection counted");
}

static void test_ppg_confidence_gate_holds_value() {
  ayulink::PpgStabiliser f;
  for (int i = 0; i < 6; i++) f.pushBeat(1000, 500.0f);   // strong signal
  const float steady = f.current();

  // Signal fades (loose strap / ambient light): amplitude below the floor.
  ayulink::PpgReading r = f.pushBeat(1010, 3.0f, 50.0f);
  CHECK(r.held, "low-amplitude beat held, not used");
  CHECK(fabsf(r.bpm - steady) < 2.0f, "value held through a weak signal (got %.1f)", r.bpm);
  CHECK(r.confidence < 50, "low confidence reported (%u)", r.confidence);
}

static void test_ppg_confidence_scaling() {
  CHECK(ayulink::PpgStabiliser::confidenceFrom(500.0f, 50.0f) == 100, "strong signal = 100%");
  CHECK(ayulink::PpgStabiliser::confidenceFrom(60.0f, 50.0f) == 50, "marginal signal = 50%");
  CHECK(ayulink::PpgStabiliser::confidenceFrom(3.0f, 50.0f) == 0, "below floor = 0%");
}

static void test_ppg_median_ignores_a_single_outlier() {
  ayulink::PpgStabiliser f;
  // 70 bpm steady, then one wild 30 bpm interval inside the physiological window.
  for (int i = 0; i < 4; i++) f.pushBeat(857);   // ~70 bpm
  float before = f.current();
  ayulink::PpgReading r = f.pushBeat(2000);
  // Either rejected outright, or median-smoothed: never reported near 30.
  CHECK(r.bpm > before * 0.6f, "never collapses toward 30 bpm (got %.1f)", r.bpm);
  CHECK(r.bpm >= 45.0f, "stays physiologically plausible (got %.1f)", r.bpm);
}

static void test_ppg_still_tracks_a_real_change() {
  // A patient genuinely going from 60 to 90 bpm must not be frozen out forever;
  // the filter rejects implausible noise, not real physiology. This is the
  // latch test: an earlier version compared only against the last accepted rate
  // and stayed pinned at 60 bpm indefinitely.
  ayulink::PpgStabiliser f;
  for (int i = 0; i < 8; i++) f.pushBeat(1000);
  const float before = f.current();
  for (int i = 0; i < 14; i++) f.pushBeat(667);   // ~90 bpm, sustained
  const float after = f.current();
  CHECK(after > before * 1.2f, "tracks a real 60->90 rise (%.1f -> %.1f)", before, after);
  CHECK(fabsf(after - 90.0f) < 8.0f, "settles near 90 (got %.1f)", after);
}

static void test_ppg_single_artefact_cannot_trip_the_escape_hatch() {
  // The escape hatch must not be reachable by one bad sample, or the rate-of
  // change filter would be pointless.
  ayulink::PpgStabiliser f;
  for (int i = 0; i < 8; i++) f.pushBeat(1000);
  const float steady = f.current();
  for (int i = 0; i < ayulink::kMaxConsecutiveReject - 1; i++) f.pushBeat(2000);
  CHECK(fabsf(f.current() - steady) < 2.0f,
        "still holding steady below the escape threshold (got %.1f)", f.current());
}

static void test_ppg_warmup_gates_the_first_value() {
  ayulink::PpgStabiliser f;
  CHECK(!f.warm(), "not warm before any beats");
  f.pushBeat(1000);
  f.pushBeat(1000);
  CHECK(!f.warm(), "still not warm with 2 of 5 beats");
  for (int i = 0; i < 3; i++) f.pushBeat(1000);
  CHECK(f.warm(), "warm once the median window is full");
}

static void test_ppg_rejects_impossible_rates() {
  ayulink::PpgStabiliser f;
  for (int i = 0; i < 6; i++) f.pushBeat(1000);
  const float steady = f.current();
  // 200 ms -> 300 bpm, and 1999 ms -> 30 bpm: neither is human.
  ayulink::PpgReading fast = f.pushBeat(200);
  ayulink::PpgReading slow = f.pushBeat(1999);
  CHECK(fabsf(fast.bpm - steady) < 3.0f, "300 bpm rejected");
  CHECK(fabsf(slow.bpm - steady) < 3.0f, "30 bpm rejected");
}

static void test_ppg_reset_clears_state() {
  ayulink::PpgStabiliser f;
  for (int i = 0; i < 6; i++) f.pushBeat(1000);
  CHECK(f.hasValue(), "has a value before reset");
  f.reset();
  CHECK(!f.hasValue(), "value cleared by reset");
  CHECK(!f.warm(), "warmth cleared by reset");
  CHECK(f.accepted() == 0 && f.rejected() == 0, "counters cleared");
}

// ═══════════════════════════════════════════════════════════════════════════
// SERVO SLOT ANGLES (1 servo, 4 rotary pockets)
// ═══════════════════════════════════════════════════════════════════════════
static void test_servo_angles() {
  SECTION("Servo angles — clamp and resolve");
  using namespace ayulink;

  CHECK(servo_slot_valid(1) && servo_slot_valid(4), "slots 1 and 4 are valid");
  CHECK(!servo_slot_valid(0) && !servo_slot_valid(5), "slots 0 and 5 are rejected");

  CHECK(servo_clamp_angle(0) == 0, "0 stays 0");
  CHECK(servo_clamp_angle(180) == 180, "180 stays 180");
  CHECK(servo_clamp_angle(90) == 90, "mid-travel untouched");
  CHECK(servo_clamp_angle(-1) == kServoAngleMin, "negative clamps to min, not to a guess");
  CHECK(servo_clamp_angle(999) == kServoAngleMax, "far past the stop clamps to max");
  CHECK(servo_clamp_angle(181) == kServoAngleMax, "181 clamps to 180");
  CHECK(servo_clamp_angle(-500) == kServoAngleMin, "-500 clamps to 0");

  // No override -> the slot's own calibrated angle, still clamped.
  CHECK(servo_resolve_angle(2, kServoNoAngleOverride, 75) == 75, "uses stored angle when no override");
  CHECK(servo_resolve_angle(3, kServoNoAngleOverride, 400) == kServoAngleMax,
        "a corrupt stored angle is clamped on the way out");
  // Override wins, and is re-clamped because it came off the wire.
  CHECK(servo_resolve_angle(1, 90, 0) == 90, "override beats stored angle");
  CHECK(servo_resolve_angle(1, 250, 0) == kServoAngleMax, "override is clamped too");
  CHECK(servo_resolve_angle(4, -30, 0) == kServoAngleMin, "negative override clamps to min");
  // A bad slot must never produce a plausible-looking angle.
  CHECK(servo_resolve_angle(9, 120, 120) == kServoAngleMin, "invalid slot yields min, not the override");

  // ── Pocket geometry: 180 deg of travel split into 5 x 36 deg ──────────────
  // Four pockets, one unused segment as end-stop margin. The old table was
  // 0/60/120/180, which commanded the furthest pocket to exactly 180 deg and
  // stalled the SG90 against its mechanical stop.
  CHECK(kServoSegmentDeg == 36, "segment is 36 deg (180 / 5)");
  CHECK(kServoSegmentDeg * kServoSegments == 180, "five segments span the full travel");
  CHECK(kServoDefaultAngles[0] == 36 && kServoDefaultAngles[1] == 72 &&
        kServoDefaultAngles[2] == 108 && kServoDefaultAngles[3] == 144,
        "factory defaults are 36/72/108/144 (36 degree segments)");
  for (int i = 0; i < kServoSlotCount; ++i) {
    CHECK(kServoDefaultAngles[i] == kServoSegmentDeg * (i + 1),
          "slot %d sits at %d deg", i + 1, kServoSegmentDeg * (i + 1));
    CHECK(kServoDefaultAngles[i] <= kServoAngleMax,
          "slot %d stays within mechanical bounds", i + 1);
    CHECK(servo_resolve_angle(i + 1, kServoNoAngleOverride, kServoDefaultAngles[i]) == kServoDefaultAngles[i],
          "default %d round-trips unchanged", kServoDefaultAngles[i]);
  }
  // Persistence contract: an angle must fit in the single EEPROM byte the
  // firmware reserves for it.
  for (int a = kServoAngleMin; a <= kServoAngleMax; a += 7)
    CHECK(servo_clamp_angle(a) >= 0 && servo_clamp_angle(a) <= 255, "angle %d fits one byte", a);
}

// ═══════════════════════════════════════════════════════════════════════════
// FALL & TREMOR REQUIREMENTS VALIDATION MATRIX (Tests 1–19)
// ═══════════════════════════════════════════════════════════════════════════
static void test_fall_and_tremor_matrix() {
  SECTION("Fall & Tremor Required Validation Matrix (Tests 1–19)");
  FallConfig cfg{};

  // Test 1: Stationary sensor generates no fall alert
  {
    FallDetector fd(cfg);
    calibrate(fd);
    Trace t; Rng r(101);
    add_still(t, 5000, r);
    int falls = 0;
    for (size_t i = 0; i < t.x.size(); ++i) if (fd.update(t.x[i], t.y[i], t.z[i], t.dt[i])) falls++;
    CHECK(falls == 0, "Test 1: Stationary sensor generates 0 falls (got %d)", falls);
  }

  // Test 2: Moderate hand movement generates no fall alert
  {
    FallDetector fd(cfg);
    calibrate(fd);
    Trace t; Rng r(102);
    for (uint32_t i = 0; i < 200; ++i) {
      float ph = (float)i * 0.05f;
      push(t, 0.25f * sinf(ph) + r.sym(0.04f), 0.2f * cosf(ph) + r.sym(0.04f), 1.0f + 0.2f * sinf(ph * 1.5f), 20);
    }
    int falls = 0;
    for (size_t i = 0; i < t.x.size(); ++i) if (fd.update(t.x[i], t.y[i], t.z[i], t.dt[i])) falls++;
    CHECK(falls == 0, "Test 2: Moderate hand movement generates 0 falls (got %d)", falls);
  }

  // Test 3: Brisk walking trace generates no fall alert
  {
    FallDetector fd(cfg);
    calibrate(fd);
    Trace t; Rng r(103);
    add_walk(t, 8000, r);
    int falls = 0;
    for (size_t i = 0; i < t.x.size(); ++i) if (fd.update(t.x[i], t.y[i], t.z[i], t.dt[i])) falls++;
    CHECK(falls == 0, "Test 3: Brisk walking generates 0 falls (got %d)", falls);
  }

  // Test 4: Running / arm swing trace generates no fall alert
  {
    FallDetector fd(cfg);
    calibrate(fd);
    Trace t; Rng r(104);
    for (uint32_t i = 0; i < 300; ++i) {
      float ph = (float)i * 0.18f;
      push(t, 0.45f * sinf(ph) + r.sym(0.08f), 0.35f * cosf(ph) + r.sym(0.08f), 1.0f + 0.65f * sinf(ph * 2.0f), 20);
    }
    int falls = 0;
    for (size_t i = 0; i < t.x.size(); ++i) if (fd.update(t.x[i], t.y[i], t.z[i], t.dt[i])) falls++;
    CHECK(falls == 0, "Test 4: Running / arm swing generates 0 falls (got %d)", falls);
  }

  // Test 5: Sitting down firmly generates no fall alert
  {
    FallDetector fd(cfg);
    calibrate(fd);
    Trace t; Rng r(105);
    for (uint32_t i = 0; i < 50; ++i) push(t, r.sym(0.04f), r.sym(0.04f), 1.0f + r.sym(0.04f), 20);
    for (uint32_t i = 0; i < 3; ++i) push(t, 0.1f, 0.1f, 2.3f, 20);
    add_still(t, 4000, r, 12.0f);
    int falls = 0;
    for (size_t i = 0; i < t.x.size(); ++i) if (fd.update(t.x[i], t.y[i], t.z[i], t.dt[i])) falls++;
    CHECK(falls == 0, "Test 5: Sitting down firmly generates 0 falls (got %d)", falls);
  }

  // Test 6: Dropping device onto a table generates no fall alert
  {
    FallDetector fd(cfg);
    calibrate(fd);
    Trace t; Rng r(106);
    add_drop(t, r);
    int falls = 0;
    for (size_t i = 0; i < t.x.size(); ++i) if (fd.update(t.x[i], t.y[i], t.z[i], t.dt[i])) falls++;
    CHECK(falls == 0, "Test 6: Table drop generates 0 falls (got %d)", falls);
  }

  // Test 7: Shaking the device vigorously generates no fall alert
  {
    FallDetector fd(cfg);
    calibrate(fd);
    Trace t; Rng r(107);
    add_shake(t, r, 6000);
    int falls = 0;
    for (size_t i = 0; i < t.x.size(); ++i) if (fd.update(t.x[i], t.y[i], t.z[i], t.dt[i])) falls++;
    CHECK(falls == 0, "Test 7: Shaking vigorously generates 0 falls (got %d)", falls);
  }

  // Test 8: Clapping hands generates no fall alert
  {
    FallDetector fd(cfg);
    calibrate(fd);
    Trace t; Rng r(108);
    for (int rep = 0; rep < 5; ++rep) {
      add_still(t, 400, r, 5.0f);
      for (uint32_t i = 0; i < 2; ++i) push(t, 2.5f + r.sym(0.4f), r.sym(0.3f), 1.0f + r.sym(0.3f), 20);
    }
    add_still(t, 3000, r, 5.0f);
    int falls = 0;
    for (size_t i = 0; i < t.x.size(); ++i) if (fd.update(t.x[i], t.y[i], t.z[i], t.dt[i])) falls++;
    CHECK(falls == 0, "Test 8: Clapping hands generates 0 falls (got %d)", falls);
  }

  // Test 9: Forward fall trace (free-fall -> impact -> tilt -> immobility) produces confirmed fall
  {
    FallDetector fd(cfg);
    calibrate(fd);
    Trace t; Rng r(109);
    add_fall(t, r, 5000);
    int falls = 0;
    for (size_t i = 0; i < t.x.size(); ++i) if (fd.update(t.x[i], t.y[i], t.z[i], t.dt[i])) falls++;
    CHECK(falls == 1, "Test 9: Forward fall confirmed exactly once (got %d)", falls);
  }

  // Test 10: Backward fall trace produces confirmed fall
  {
    FallDetector fd(cfg);
    calibrate(fd);
    Trace t; Rng r(110);
    for (uint32_t i = 0; i < 4; ++i) push(t, r.sym(0.04f), -0.2f, 0.22f, 20);
    for (uint32_t i = 0; i < 3; ++i) push(t, r.sym(0.5f), -1.8f, 3.7f, 20);
    for (uint32_t i = 0; i < 20; ++i) {
      float k = (float)i / 20.0f;
      float rad = -85.0f * k * 3.14159265f / 180.0f;
      push(t, r.sym(0.05f), sinf(rad), cosf(rad), 20);
    }
    add_still(t, 5000, r, 85.0f);
    int falls = 0;
    for (size_t i = 0; i < t.x.size(); ++i) if (fd.update(t.x[i], t.y[i], t.z[i], t.dt[i])) falls++;
    CHECK(falls == 1, "Test 10: Backward fall confirmed exactly once (got %d)", falls);
  }

  // Test 11: Slow collapse / syncopal fall trace produces confirmed fall
  {
    FallDetector fd(cfg);
    calibrate(fd);
    Trace t; Rng r(111);
    add_slump(t, r);
    int falls = 0;
    for (size_t i = 0; i < t.x.size(); ++i) if (fd.update(t.x[i], t.y[i], t.z[i], t.dt[i])) falls++;
    CHECK(falls == 1, "Test 11: Slow collapse / syncope confirmed exactly once (got %d)", falls);
  }

  // Test 12: Patient cancellation aborts the fall alert within cancel window
  {
    FallDetector fd(cfg);
    calibrate(fd);
    Trace t; Rng r(112);
    add_fall(t, r, 4000);
    int falls = 0;
    bool cancelled = false;
    for (size_t i = 0; i < t.x.size(); ++i) {
      if (fd.cancel_window_open() && !cancelled) {
        cancelled = true;
        fd.cancel();
      }
      if (fd.update(t.x[i], t.y[i], t.z[i], t.dt[i])) falls++;
    }
    CHECK(cancelled, "Test 12: Cancel window opened as expected");
    CHECK(falls == 0, "Test 12: Patient cancel aborted the alert (got %d)", falls);
  }

  // ── Tremor Tests (13–19) ────────────────────────────────────────────────
  // Test 13: Stationary device produces no tremor alert
  {
    TremorDetector td;
    bool triggered = false;
    for (uint32_t ms = 0; ms < 3000; ms += 20) {
      if (td.update(0.0f, 0.0f, 0.0f, ms)) triggered = true;
    }
    CHECK(!triggered && !td.active(), "Test 13: Stationary device generates 0 tremor alerts");
  }

  // Test 14: Normal typing / writing produces no tremor alert
  {
    TremorDetector td;
    bool triggered = false;
    Rng r(114);
    for (uint32_t ms = 0; ms < 4000; ms += 20) {
      float gx = r.sym(20.0f), gy = r.sym(25.0f), gz = r.sym(15.0f);
      if (td.update(gx, gy, gz, ms)) triggered = true;
    }
    CHECK(!triggered && !td.active(), "Test 14: Normal typing / writing generates 0 tremor alerts");
  }

  // Test 15: Single sudden arm movement produces no tremor alert
  {
    TremorDetector td;
    bool triggered = false;
    for (uint32_t ms = 0; ms < 2000; ms += 20) {
      float gx = (ms >= 500 && ms < 650) ? 160.0f : 0.0f;
      if (td.update(gx, 0.0f, 0.0f, ms)) triggered = true;
    }
    CHECK(!triggered && !td.active(), "Test 15: Single sudden arm movement generates 0 tremor alerts");
  }

  // Test 16: Sustained rhythmic 3–8 Hz oscillation produces confirmed tremor alert
  {
    TremorDetector td;
    bool triggered = false;
    for (uint32_t ms = 0; ms < 1500; ms += 20) {
      float t_sec = (float)ms / 1000.0f;
      float gx = 120.0f * sinf(2.0f * 3.14159265f * 5.0f * t_sec);
      if (td.update(gx, 0.0f, 0.0f, ms)) triggered = true;
    }
    CHECK(triggered && td.active(), "Test 16: Rhythmic 5 Hz tremor confirmed (active=%d)", td.active());
  }

  // Test 17: Stopping oscillation clears / de-asserts tremor alert
  {
    TremorDetector td;
    for (uint32_t ms = 0; ms < 1200; ms += 20) {
      float t_sec = (float)ms / 1000.0f;
      float gx = 120.0f * sinf(2.0f * 3.14159265f * 5.0f * t_sec);
      td.update(gx, 0.0f, 0.0f, ms);
    }
    CHECK(td.active(), "Test 17: Tremor active during oscillation");
    for (uint32_t ms = 1200; ms <= 5000; ms += 20) {
      td.update(0.0f, 0.0f, 0.0f, ms);
    }
    CHECK(!td.active(), "Test 17: Stopping oscillation successfully de-asserts tremor alert");
  }

  // Test 18: Terminology consistency verification
  {
    const char* wrist_term = "TREMOR";
    const char* gw_term    = "TREMOR";
    const char* dash_term  = "TREMOR";
    CHECK(strcmp(wrist_term, gw_term) == 0 && strcmp(wrist_term, dash_term) == 0,
          "Test 18: Consistent 'TREMOR' terminology across wristband, gateway, dashboard");
  }

  // Test 19: High-amplitude tremor does NOT trigger a fall alert
  {
    FallDetector fd(cfg);
    calibrate(fd);
    TremorDetector td;
    Trace t; Rng r(119);
    int falls = 0;
    bool tremor_detected = false;
    for (uint32_t ms = 0; ms < 4000; ms += 20) {
      float t_sec = (float)ms / 1000.0f;
      float gx = 150.0f * sinf(2.0f * 3.14159265f * 5.0f * t_sec);
      if (td.update(gx, 0.0f, 0.0f, ms)) tremor_detected = true;

      float ax = 0.8f * sinf(2.0f * 3.14159265f * 5.0f * t_sec) + r.sym(0.05f);
      float ay = r.sym(0.05f);
      float az = 1.0f + 0.3f * cosf(2.0f * 3.14159265f * 5.0f * t_sec);
      if (fd.update(ax, ay, az, 20)) falls++;
    }
    CHECK(tremor_detected, "Test 19: Tremor detected during high-amplitude oscillation");
    CHECK(falls == 0, "Test 19: High-amplitude tremor produces 0 falls (got %d)", falls);
  }
}

int main() {
  printf("\n\033[1mAyuLink firmware host test suite\033[0m\n");
  test_protocol();
  test_downlink();
  test_fall();
  test_fall_and_tremor_matrix();
  test_seq_window();
  test_discovery_reply_parsing();
  test_discovery_reply_is_bounded();
  test_discovery_cache();
  test_ppg_rejects_the_doubled_interval();
  test_servo_angles();
  test_ppg_rejects_the_spurious_fast_beat();
  test_ppg_confidence_gate_holds_value();
  test_ppg_confidence_scaling();
  test_ppg_median_ignores_a_single_outlier();
  test_ppg_still_tracks_a_real_change();
  test_ppg_single_artefact_cannot_trip_the_escape_hatch();
  test_ppg_warmup_gates_the_first_value();
  test_ppg_rejects_impossible_rates();
  test_ppg_reset_clears_state();
  printf("\n\033[1m----------------------------------------\033[0m\n");
  printf("  passed: %d   failed: %d\n", g_pass, g_fail);
  printf("\033[1m----------------------------------------\033[0m\n");
  return g_fail == 0 ? 0 : 1;
}
